## firmware/main/Kconfig.projbuild
```kconfig
rsource "Kconfig.board"

menu "PET modules"

config PET_SETUP_PORTAL_ENABLED
    bool "Enable local SoftAP web setup"
    depends on PET_MODULE_NET_ENABLED && !PET_NET_FAKE && PET_MODULE_UI_ENABLED
    default y
    help
      First boot with no Wi-Fi opens a password-protected SoftAP for 15 minutes.
      The LCD shows the temporary connection details; setup can also be reopened
      from the BOOT menu. Supports Wi-Fi-only use and optional Xiaozhi binding.

config PET_PROVISION_CONSOLE_ENABLED
    bool "Enable physical serial configuration commands"
    default n
    help
      Physical serial PET_SETTINGS/PET_PROVISION commands; disabled by default.
      Stores one validated credential bundle without erasing existing namespaces.
      Never echoes credentials. New credentials take effect after explicit reboot.

config PET_RECOVERY_ENABLED
    bool "Isolate optional services after three early crash resets"
    depends on PET_PROVISION_CONSOLE_ENABLED
    default n
    help
      RTC memory counts consecutive panic/watchdog resets before 30 seconds of
      healthy operation. The third enters a USB maintenance boot without audio,
      network or extensions. PET_RECOVERY_CLEAR clears the next boot's latch.
      When UI is enabled, a minimal screen and BOOT retry are attempted once
      per recovery latch. Further restarts use USB only, avoiding a display crash loop.
      Cold power-on clears RTC history. No NVS writes or automatic data erase.

config PET_MODULE_AI_ENABLED
    bool "Enable AI session engine and runtime library"
    default y
    help
      Compile the session engine and runtime library. With audio enabled,
      include the opt-in owner task API; the composition root must supply
      audio and transport adapters explicitly. This alone does not start a
      task, microphone, wake-word detector or cloud connection.

config PET_MODULE_AUDIO_ENABLED
    bool "Enable audio HAL and loopback service"
    default y
    help
      INMP441 I2S RX and MAX98357A I2S TX. Normal starts stay half-duplex;
      a separate explicit diagnostic entry supports parallel RX/TX.
      Enabling this alone does not activate the microphone or speaker.

config PET_AI_XIAOZHI_ENABLED
    bool "Compile Xiaozhi v1 protocol and Opus adapter library"
    depends on PET_MODULE_AI_ENABLED && PET_MODULE_AUDIO_ENABLED
    default y
    help
      Compile single-turn WebSocket v1 framing with 60 ms mono Opus.
      This library does not create a network task, connect to a server or
      bind the AI owner task; those require an explicit transport worker.

config PET_MESSAGE_TONES_ON_BOOT
    bool "Start notification-only audio owner when boot AI is disabled"
    depends on PET_MODULE_AI_ENABLED && PET_MODULE_AUDIO_ENABLED && !PET_AI_XIAOZHI_ON_BOOT && !PET_AUDIO_DIAGNOSTIC_ON_BOOT
    default n
    help
      Explicitly starts the shared speaker owner for message chimes. Does not
      create a network transport or capture audio. Mute and DND still apply.

config PET_AI_XIAOZHI_WSS_ENABLED
    bool "Compile Xiaozhi WSS transport worker"
    depends on PET_AI_XIAOZHI_ENABLED && PET_MODULE_NET_ENABLED && !PET_NET_FAKE && SPIRAM
    depends on WS_TRANSPORT && MBEDTLS_CERTIFICATE_BUNDLE
    default y
    help
      Compile the separate network/codec owner and bounded PSRAM queues.
      This alone does not start a task, connect to a server or record audio.
      Each turn requires an IP address, SNTP, verified TLS and a new socket.

config PET_AI_XIAOZHI_ON_BOOT
    bool "Start AI and Xiaozhi WSS services on boot"
    depends on PET_AI_XIAOZHI_WSS_ENABLED && !PET_AUDIO_DIAGNOSTIC_ON_BOOT && !PET_UI_DND
    default n
    help
      Explicit opt-in composition of the audio owner and WSS worker. Requires
      NVS xiaozhi/ws_uri, ws_token, device_id and client_id; ws_ca is optional.
      Missing or invalid credentials skip startup. No credentials are baked
      into sdkconfig, and there is no automatic activation/OTA provisioning.
      Without ESP-SR, a deliberate input is required to start a turn. With UI enabled, the
      existing BOOT menu provides push-to-talk, mute and runtime DND.
      With PET_AI_ESP_SR_ENABLED, idle local wake-word listening starts after
      initialization; only a wake-word or deliberate input starts a cloud turn.
      Mutually exclusive with boot audio diagnostics and boot DND.

config PET_AI_CONVERSATION
    bool "Enable continuous conversation window after each reply"
    depends on PET_AI_XIAOZHI_ON_BOOT
    default y
    help
      M1 session keep-alive: after a reply finishes playing, keep the WSS
      connection and capture running for a bounded window (10 s, max 20
      rounds / 5 minutes per episode). Speech detected in the window starts
      the next turn without a new wake word; timeout, mute, cancel or a
      deliberate END_TALK input returns to idle. The provider keeps the
      dialogue context; the device never uploads PCM while only waiting.

config PET_AI_DSP_ENABLED
    bool "Enable ESP-SR noise-suppression frontend"
    depends on PET_MODULE_AI_ENABLED && PET_MODULE_AUDIO_ENABLED && SPIRAM && !PET_AUDIO_FAKE
    default n
    help
      Processes 16 kHz 20 ms frames before wake/VAD/upload. Half-duplex remains
      the production audio policy. Requires on-board acoustic verification.

config PET_AI_AEC_REFERENCE_ENABLED
    bool "Enable calibrated AEC reference port (diagnostic integration)"
    depends on PET_AI_DSP_ENABLED
    default n
    help
      AEC only runs with a genuine fresh 16 kHz reference submitted by the same
      audio owner. The normal AI owner supplies no calibrated reference and
      falls back to noise suppression. This option does not activate the
      separate parallel I/O diagnostic or enable duplex conversation.

config PET_AI_ESP_SR_ENABLED
    bool "Compile WakeNet/VAD frontend (boot AI listens for wake word)"
    depends on PET_MODULE_AI_ENABLED && PET_MODULE_AUDIO_ENABLED && SPIRAM && !PET_AUDIO_FAKE
    default n
    help
      ESP-SR 2.5.5, wn9_xiaoaitongxue and vadnet1_medium. Requires MODEL_IN_FLASH,
      SR_WN_WN9_XIAOAITONGXUE and SR_VADN_VADNET1_MEDIUM, with no extra models.
      See sdkconfig.ai-sr.defaults for the opt-in configuration. With boot AI
      enabled and valid NVS credentials, opens local wake-word capture while idle.
      Mute, DND, critical interruption, thinking and playback stop capture.
      Half duplex; no AFE/AEC or acoustic barge-in. Model failure locks the AI
      service until reboot, rather than silently recording with a fallback.

config PET_AI_VOLUME_PCT
    int "AI playback volume (%)"
    depends on PET_AI_XIAOZHI_ON_BOOT
    range 0 100
    default 25

config PET_AUDIO_FAKE
    bool "Use deterministic fake audio device"
    depends on PET_MODULE_AUDIO_ENABLED
    default n
    help
      Generate a 400 Hz square wave and consume playback without hardware.
      Logical drain is not evidence of real I2S transmission.

config PET_AUDIO_DIAGNOSTIC_ON_BOOT
    bool "Run a one-shot boot audio diagnostic"
    depends on PET_MODULE_AUDIO_ENABLED && !PET_UI_DND
    default n
    help
      Explicit opt-in test; runs once in a separate task. Select record/replay
      or the bounded parallel I/O probe below. Neither uploads or persists
      audio or changes BOOT button behavior. Excludes the boot AI/tone owner.

choice PET_AUDIO_DIAGNOSTIC_MODE
    prompt "Boot audio diagnostic mode"
    depends on PET_AUDIO_DIAGNOSTIC_ON_BOOT
    default PET_AUDIO_DIAGNOSTIC_LOOPBACK

config PET_AUDIO_DIAGNOSTIC_LOOPBACK
    bool "Record 16 kHz for one second, then replay at 25%"

config PET_AUDIO_DIAGNOSTIC_DUPLEX
    bool "Probe parallel 16 kHz capture and 24 kHz synthesized playback"
    depends on !PET_AUDIO_FAKE
    help
      Capture and submit a quiet 400 Hz tone for one second, then stop RX
      before draining TX. Logs only counts, peak and software timing.
      Does not provide a calibrated AEC reference or enable acoustic barge-in.

endchoice

config PET_MODULE_UI_ENABLED
    bool "Enable ST7789 message UI and BOOT confirmation"
    depends on PET_MODULE_NET_ENABLED
    default y
    help
      LVGL message cards with durable inbox snapshots and displayed/read ACKs.
      A failed display does not acknowledge messages as displayed.

config PET_UI_DND
    bool "Boot DND: suppress normal/low popups and AI audio"
    depends on PET_MODULE_UI_ENABLED
    default n
    help
      Local DND fallback until retained device configuration is implemented.
      High and critical remain visible; BOOT can browse queued unread messages.
      Runtime DND in the voice menu also gates AI capture and playback.

config PET_MODULE_GROWTH_ENABLED
    bool "Enable growth module"
    default y
    help
      Local growth rules, transactional saves and periodic settlement. Disable to verify the
      composition root builds without it.

config PET_GROWTH_SYNC_ENABLED
    bool "Publish read-only growth snapshots to CORE"
    depends on PET_MODULE_GROWTH_ENABLED && PET_MODULE_NET_ENABLED
    default n
    help
      Publish non-retained growth display data every 15 seconds after time synchronization.
      This does not merge CORE rewards or replace the local save.

config PET_GROWTH_UTC_OFFSET_MINUTES
    int "Growth calendar UTC offset in minutes"
    depends on PET_MODULE_GROWTH_ENABLED
    range -720 840
    default 480
    help
      Fixed local offset for the daily 04:00 reset and night state. DST is not applied.

config PET_MODULE_CLIMATE_ENABLED
    bool "Enable optional DHT11 climate extension"
    default n
    help
      Temperature/humidity sampling, filtering, alerts and daily extremes
      (components/svc_climate). The release hardware does not include this
      sensor. Enable only after wiring the optional extension; disabled builds
      do not sample a floating pin or show its menu entry.

config PET_CLIMATE_FAKE_SENSOR
    bool "Use fake climate sensor"
    depends on PET_MODULE_CLIMATE_ENABLED
    default n
    help
      Use a deterministic in-memory sensor instead of DHT11. Intended for
      desk testing and CI builds without hardware.

config PET_CLIMATE_DHT11_GPIO
    int "DHT11 data GPIO"
    depends on PET_MODULE_CLIMATE_ENABLED && !PET_CLIMATE_FAKE_SENSOR
    range 0 48
    default PET_BOARD_DHT11_GPIO
    help
      DHT11 single-wire data pin. Default matches the DODO-S3-LCD wiring.

config PET_CLIMATE_SAMPLE_PERIOD_MS
    int "Climate sample period (ms)"
    depends on PET_MODULE_CLIMATE_ENABLED
    range 2000 60000
    default 5000
    help
      Sampling period for the climate task. DHT11 requires at least 2 s.

config PET_MODULE_NET_ENABLED
    bool "Enable network transport"
    default y
    help
      Wi-Fi station + MQTT over TLS transport (components/svc_net). Disable to
      verify the composition root builds without networking.

config PET_NET_FAKE
    bool "Use fake network transport"
    depends on PET_MODULE_NET_ENABLED
    default n
    help
      Use a deterministic in-memory transport instead of Wi-Fi/MQTT. Intended
      for desk testing and CI builds without hardware or a broker.

config PET_NET_WIFI_SSID
    string "Wi-Fi SSID (development fallback)"
    depends on PET_MODULE_NET_ENABLED && !PET_NET_FAKE
    default ""
    help
      Used only when NVS namespace "net" has no "wifi_ssid" entry. Leave empty
      to skip networking until the device is provisioned.

config PET_NET_WIFI_PASSWORD
    string "Wi-Fi password (development fallback)"
    depends on PET_MODULE_NET_ENABLED && !PET_NET_FAKE
    default ""
    help
      Used only when NVS namespace "net" has no "wifi_pass" entry.

config PET_NET_BROKER_URI
    string "MQTT broker URI (development fallback)"
    depends on PET_MODULE_NET_ENABLED && !PET_NET_FAKE
    default ""
    help
      mqtts:// URI, for example mqtts://192.168.1.10:8883. Used only when NVS
      namespace "nexus" has no "mqtt_uri" entry.

config PET_NET_DEVICE_ID
    string "Device ID"
    depends on PET_MODULE_NET_ENABLED
    default "pet-dev-01"
    help
      MQTT client ID and topic segment. NVS namespace "nexus" key "device_id"
      takes precedence. Must match nexus-core: 1-40 ASCII letters, digits,
      underscores or hyphens (dots are not accepted).

config PET_NET_MQTT_USERNAME
    string "MQTT username (development fallback)"
    depends on PET_MODULE_NET_ENABLED && !PET_NET_FAKE
    default ""

config PET_NET_MQTT_PASSWORD
    string "MQTT password (development fallback)"
    depends on PET_MODULE_NET_ENABLED && !PET_NET_FAKE
    default ""

config PET_NET_KEEPALIVE_S
    int "MQTT keepalive (s)"
    depends on PET_MODULE_NET_ENABLED
    range 10 3600
    default 60

config PET_NET_RECONNECT_MS
    int "Reconnect base timeout (ms)"
    depends on PET_MODULE_NET_ENABLED
    range 500 60000
    default 2000
    help
      Base delay for Wi-Fi retries and the esp-mqtt reconnect timeout.
      Wi-Fi retries back off exponentially up to 30 s.

endmenu

menu "PET signed OTA"

config PET_OTA_ENABLED
    bool "Enable signed application OTA (requires USB bootloader bootstrap)"
    depends on PET_MODULE_NET_ENABLED
    default n
    help
      RSA-3072-PSS manifest, HTTPS, inactive app only and rollback health check.
      Never writes the single model partition; changing models requires a USB recovery package.

config PET_OTA_REMOTE_ENABLED
    bool "Enable journaled CORE remote OTA management"
    depends on PET_OTA_ENABLED
    default n
    help
      Requires paired CORE and ota/ota_acks/ota_status device-scoped broker ACL.
      Commands bind the current boot ID and a short lifetime. Reboot needs a separate request.

config PET_OTA_BASE_URL
    string "Pinned HTTPS release root (no trailing slash)"
    depends on PET_OTA_ENABLED
    default ""

config PET_OTA_PUBLIC_KEY_DER
    string "Absolute RSA-3072 PKCS#1 public DER path"
    depends on PET_OTA_ENABLED
    default ""

endmenu

menu "PET extensions"

config PET_EXT_JOYSTICK
    bool "Enable optional analog joystick menu input"
    depends on PET_MODULE_UI_ENABLED
    default n
    help
      KY-023 style 3.3V joystick: X GPIO4, Y GPIO5, active-low SW GPIO6.
      Up/down select, right opens/executes, left returns; hold SW for voice.
      Requires released neutral after boot/fault/preemption. BOOT remains
      available and is still required for message/control/recovery confirmation.
      This is explicit configuration, not automatic hot-plug detection.

config PET_INPUT_TRIPLE
    bool "Enable triple physical keys (confirm/next/voice)"
    depends on PET_MODULE_UI_ENABLED
    default y
    help
      KEY_A GPIO13 confirm, KEY_B GPIO14 next/back, KEY_C GPIO41 voice/mute;
      all active-low with internal pull-ups. Hal layer only debounces (30 ms)
      and classifies short (<800 ms), long (>=800 ms) and two-key combos
      (overlap window 300 ms); business mapping lives in the UI layer per
      docs/27. Requires the keys to be wired; boards without wiring must
      disable this to keep BOOT-only semantics.

config PET_EXT_LIGHT_SENSOR
    bool "Enable optional ambient-light backlight control"
    depends on PET_MODULE_UI_ENABLED
    default n
    help
      3.3V analog light module AO on ADC1 GPIO7. Samples every 500 ms;
      smooths relative light without claiming lux calibration. User brightness
      remains a ceiling, 0 stays off, errors restore manual brightness.
      Requires an active-high PWM backlight driver on GPIO42. Disabled by
      default; recovery never reads this optional sensor.

config PET_LIGHT_SENSOR_INVERT
    bool "Invert light sensor (raw voltage falls as light increases)"
    depends on PET_EXT_LIGHT_SENSOR
    default n

config PET_JOYSTICK_INVERT_X
    bool "Invert joystick X axis"
    depends on PET_EXT_JOYSTICK
    default n

config PET_JOYSTICK_INVERT_Y
    bool "Invert joystick Y axis"
    depends on PET_EXT_JOYSTICK
    default n

config PET_EXT_DEVICE_CONTROL
    bool "Enable device_control extension"
    depends on PET_MODULE_NET_ENABLED && PET_MODULE_UI_ENABLED
    default n
    help
      Scoped HTTPS proxy for existing mac-bridge, with local screen/BOOT
      confirmation. Requires physical provisioning of endpoint and device token.
      Disabled by default; no platform command runs at boot.

config PET_EXT_SERVO
    bool "Enable servo extension"
    default n
    help
      Servo actuator extension (extensions/servo). Disabled by default; S6
      implements LEDC output, limits and emergency stop.

config PET_SERVO_GPIO
    int "Calibrated servo PWM GPIO (-1 leaves service inactive)"
    depends on PET_EXT_SERVO
    range -1 48
    default -1

config PET_SERVO_MIN_ANGLE
    int "Calibrated minimum angle"
    depends on PET_EXT_SERVO
    range 0 179
    default 30

config PET_SERVO_MAX_ANGLE
    int "Calibrated maximum angle"
    depends on PET_EXT_SERVO
    range 1 180
    default 150

config PET_SERVO_SAFE_ANGLE
    int "Calibrated home angle"
    depends on PET_EXT_SERVO
    range 0 180
    default 90

config PET_SERVO_MAX_SPEED
    int "Maximum servo speed (degrees/s)"
    depends on PET_EXT_SERVO
    range 1 180
    default 90

endmenu
```
